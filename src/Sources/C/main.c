/******************************************************************************
【文件名】：浙大二队直立电磁车主程序Main
【日  期】：2016.07
【作  者】：HZX/SJ/SLS
【备  注】：版权所有
*******************************************************************************/
/*********************************
【dev.env.】IAR 7.2
【Target  】MK60DN512VLL10
【Crystal 】50.000  MHz
【busclock】75.000  MHz
【pllclock】150.000 MHz
*********************************/
#include "includes.h"
#include <string.h>
//uint8 blue_buffer[100];
extern uint8 ccd_ad[128];
struct CCD CCD1;
const int16 jbxs2[128]={0x0B,0x0B,0x0F,0x11,0x13,0x15,0x17,0x19,0x1C,0x1E,0x21,0x23,0x25,0x26,0x28,0x29,
                        0x2B,0x2C,0x2D,0x2E,0x2F,0x30,0x30,0x30,0x31,0x31,0x32,0x32,0x33,0x32,0x33,0x33,
                        0x33,0x33,0x33,0x33,0x34,0x33,0x33,0x33,0x33,0x33,0x33,0x33,0x33,0x33,0x33,0x33,
                        0x33,0x33,0x33,0x33,0x33,0x33,0x33,0x33,0x33,0x33,0x33,0x33,0x34,0x34,0x34,0x34,
                        0x34,0x34,0x34,0x33,0x34,0x33,0x33,0x32,0x32,0x32,0x32,0x32,0x32,0x32,0x33,0x33,
                        0x33,0x33,0x33,0x32,0x32,0x32,0x32,0x32,0x32,0x32,0x32,0x31,0x31,0x31,0x31,0x31,
                        0x31,0x31,0x31,0x31,0x30,0x30,0x30,0x30,0x2F,0x2F,0x2F,0x2E,0x2E,0x2E,0x2D,0x2D,
                        0x2C,0x2B,0x2A,0x29,0x28,0x27,0x26,0x25,0x24,0x22,0x21,0x1F,0x1D,0x1B,0x19,0x18};//例程参数2
const int16 jbxs1[128]={0x5C,0x4C,0x57,0x59,0x60,0x67,0x6E,0x74,0x7A,0x80,0x86,0x8A,0x8F,0x93,0x98,0x9B,
                        0x9E,0xA0,0xA2,0xA4,0xA5,0xA6,0xA7,0xA7,0xA9,0xAA,0xAB,0xAB,0xAD,0xAD,0xAD,0xAD,
                        0xAE,0xAE,0xAE,0xAE,0xAF,0xB0,0xB0,0xB0,0xB1,0xB1,0xB2,0xB2,0xB3,0xB4,0xB4,0xB4,
                        0xB4,0xB4,0xB4,0xB4,0xB5,0xB6,0xB7,0xB7,0xB8,0xB8,0xB8,0xB8,0xB9,0xB9,0xB9,0xB9,
                        0xB9,0xB9,0xB9,0xB9,0xB9,0xB9,0xB9,0xB9,0xB9,0xB9,0xB9,0xB9,0xB9,0xB9,0xB9,0xB9,
                        0xB9,0xB9,0xB9,0xB9,0xB9,0xB9,0xB9,0xB9,0xB9,0xB9,0xB9,0xB9,0xB9,0xB9,0xB9,0xB9,
                        0xB9,0xB9,0xB9,0xB9,0xB9,0xB9,0xB9,0xB9,0xB9,0xB9,0xB9,0xB9,0xB9,0xB9,0xB9,0xB9,
                        0xB8,0xB7,0xB5,0xB1,0xAD,0xA7,0xA2,0x9B,0x95,0x8E,0x85,0x7A,0x71,0x67,0x5E,0x58};//例程参数1
void main(void)
{
  uint8 blue_buffer[10];
  //byte test[];
  byte pwm1[10];
  byte pwm2[10];
  uint16 data_ADC;
  byte adc1[20];
 // byte pwm3[];
 // byte pwm4[];
  //byte test2[9];
  uint8 get;
  int i,j;
  for (i=0;i<10;i++)
  {
    blue_buffer[i]=0;
  }
  //uint8 ceshi_ad[128]={0x49,0x3B,0x33,0x2D,0x2E,0x2E,0x2D,0x2D,0x2D,0x2D,0x2D,0x2E,0x2E,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0x53,0x40};
  //int delay_t;
  DisableInterrupts;//禁止总中断
  
  LCD_Init();         //LCD口初始化       ///初始化顺序有要求？？？
  
  pit_init(PIT0,75000); //定时75000=1ms
  //pit_init(PIT1,10000000);//定时10000000=133ms
  pit_init(PIT1,7500000);//定时7500000=100ms
  KPInit();           //5个按键，4个拨码开关初始化  
  
  pwm_init();         //电机驱动初始化
 // quad_init();        //编码器口初始化
  
  ccd_init();
  
  CCD1.thresh=150;
  for(i=0;i<128;i++)
    {
        if (jbxs1[i]>=CCD1.max_voltage) CCD1.max_voltage=jbxs1[i];
        CCD1.cos_array[i]=jbxs1[i];
    }
  
  CCD_start();
  
  //gpio_ctrl(PORTA,19,0); //蓝色测试灯
  uart_init(UART0,periph_clk_khz,9600); //蓝牙串口初始化 
  
  hw_adc_init(Moudel_0);      //AD模块1初始化
  hw_adc_init(Moudel_1);      //AD模块2初始化
  
  enable_pit_interrupt(PIT0);          //开启中断pit0控制中端
  enable_pit_interrupt(PIT1);          //开启中断pit2按键中断
  set_irq_priority(PIT0_Vector_IRQ,0); //中断控制优先级第一
  set_irq_priority(PIT1_Vector_IRQ,1); //100ms键盘扫描次之
  
  EnableInterrupts;  //开总中断
      
 //  电机测试
  FTM0_C6V=0;
  FTM0_C7V=0;
  FTM0_C4V=0;
  FTM0_C5V=0;
  
  FTM1_C1V=920;
  
  /*strcpy(pwm1,"C4V 0200");
  strcpy(pwm2,"C1V 0200");
  LCD_P8x16Str(0,0,pwm1);
  LCD_P8x16Str(0,2,pwm2);*/
  //ccd_init();
  //CCD_start();
  
  //send_flag=0;
  //主循环蓝牙数据发送
  /*
  CCD1_scan();
    
    for(j = 0 ;j < 128; j++){
      uart_send1(FreeCarsUARTPort, (ccd_ad[j]/256));
      //uart_send1(FreeCarsUARTPort, (ccd_ad[j]%256));
    }
    uart_send1(FreeCarsUARTPort,0xff);*/
  while(1)  
  {
   /*  FTM0_C6V=1000;
  FTM0_C7V=1500;
  FTM0_C4V=500;
  FTM0_C5V=2000;*/
    
   // LCD_P8x16Str(0,0,test);
    
    //CCD1_scan();
    
    //for(j = 0 ;j < 128; j++){
      //uart_send1(FreeCarsUARTPort, (ccd_ad[j]/256));
      //uart_send1(FreeCarsUARTPort, (ccd_ad[j]%256));
      //uart_send1(FreeCarsUARTPort, (ccd_ad[j]));
    //}
    // 蓝牙上位机测试
    //ceshi_ad[14]++;
    //ceshi_ad[15]++;
    
    //CCD1_scan();
    
    /*for(j = 0 ;j < 128; j++){
      //uart_send1(FreeCarsUARTPort, (ccd_ad[j]/256));
      //uart_send1(FreeCarsUARTPort, (ccd_ad[j]%256));
      uart_send1(FreeCarsUARTPort, (ccd_ad[j]));
    }
    uart_send1(FreeCarsUARTPort,0xff);
    */
    /* // ADC 测试
    data_ADC = hw_ad_once(0,9,12);
    strcpy(adc1,"adc1 00000");
    adc1[5]='0'+data_ADC/10000;
    adc1[6]='0'+(data_ADC/1000)%10;
    adc1[7]='0'+(data_ADC/100)%10;
    adc1[8]='0'+(data_ADC/10)%10;
    adc1[9]='0'+(data_ADC/1)%10;
    LCD_P8x16Str(0,6,adc1);*/
    
   // get=uart_reN(FreeCarsUARTPort, blue_buffer, 2);
    
   if (get==1)
   {
    //FTM0_C4V=blue_buffer[0]*10;
    //FTM0_C5V=blue_buffer[1]*10;
    //FTM0_C6V=blue_buffer[2]*10;
    //FTM0_C7V=blue_buffer[3]*10;
    //for(i=0;i<100;i++);
    /*uart_send1(FreeCarsUARTPort, 0x30);
    uart_send1(FreeCarsUARTPort, blue_buffer[0]);
    uart_send1(FreeCarsUARTPort, 0x31);
    uart_send1(FreeCarsUARTPort, blue_buffer[1]);
    uart_send1(FreeCarsUARTPort, 0x32);
    uart_send1(FreeCarsUARTPort, blue_buffer[2]);
    uart_send1(FreeCarsUARTPort, 0x33);
    uart_send1(FreeCarsUARTPort, blue_buffer[3]);*/
     /*test2[0]='0'+blue_buffer[0]/16;
     test2[1]='0'+blue_buffer[0]%16;
     test2[2]='0'+blue_buffer[1]/16;
     test2[3]='0'+blue_buffer[1]%16;
     test2[4]='0'+blue_buffer[2]/16;
     test2[5]='0'+blue_buffer[2]%16;
     test2[6]='0'+blue_buffer[3]/16;
     test2[7]='0'+blue_buffer[3]%16;
     test2[8]='\0';
     LCD_P8x16Str(0,0,test);
     LCD_P8x16Str(0,2,test2);*/
     
     /*FTM0_C4V=blue_buffer[0]*10;
     FTM1_C1V=blue_buffer[1]*10;
     pwm1[4]='0'+blue_buffer[0]*10/1000;
     pwm1[5]='0'+(blue_buffer[0]*10/100)%10;
     pwm1[6]='0'+(blue_buffer[0]*10/10)%10;
     pwm1[7]='0'+(blue_buffer[0]*10)%10;
     pwm2[4]='0'+blue_buffer[1]*10/1000;
     pwm2[5]='0'+(blue_buffer[1]*10/100)%10;
     pwm2[6]='0'+(blue_buffer[1]*10/10)%10;
     pwm2[7]='0'+(blue_buffer[1]*10)%10;
     LCD_P8x16Str(0,0,pwm1);
     LCD_P8x16Str(0,2,pwm2);*/

   }
  }
}
